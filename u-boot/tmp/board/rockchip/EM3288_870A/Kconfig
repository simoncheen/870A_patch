## u-boot/tmp/board/rockchip/EM3288_870A/Kconfig
```kconfig
if TARGET_EM3288_870A

config SYS_BOARD
	default "EM3288_870A"

config SYS_VENDOR
	default "rockchip"

config SYS_CONFIG_NAME
	default "EM3288_870A"

config BOARD_SPECIFIC_OPTIONS # dummy
	def_bool y

endif
```
